## main/Kconfig.projbuild
```kconfig
menu "Bluetooth Flash Programmer"

config BT_NAME
    string "Bluetooth Name"
    default "Bluetooth Flash Programmer"

config BT_SPP_SERVER_NAME
    string "SPP Server Name"
    default "MTD"

config SPI_CS_PIN
    int "SPI CS Pin"
    default 15

config SPI_SCLK_PIN
    int "SPI SCLK Pin"
    default 14

config SPI_MOSI_PIN
    int "SPI MOSI Pin"
    default 13

config SPI_MISO_PIN
    int "SPI MISO Pin"
    default 12
endmenu
```

## sdkconfig.defaults
```kconfig
#
# Serial flasher config
#
CONFIG_ESPTOOLPY_FLASHMODE_QIO=y
CONFIG_ESPTOOLPY_FLASHFREQ_80M=y
CONFIG_ESPTOOLPY_FLASHSIZE_4MB=y

#
# Bluetooth
#
CONFIG_BT_ENABLED=y
CONFIG_BTDM_CTRL_MODE_BR_EDR_ONLY=y
CONFIG_BT_CLASSIC_ENABLED=y
CONFIG_BT_SPP_ENABLED=y
# CONFIG_BT_BLE_ENABLED is not set
CONFIG_BT_STACK_NO_LOG=y
CONFIG_BT_BLE_DYNAMIC_ENV_MEMORY=y

#
# Compiler options
#
CONFIG_COMPILER_OPTIMIZATION_SIZE=y

#
# ESP32-specific
#
CONFIG_ESP32_DEFAULT_CPU_FREQ_240=y

#
# Newlib
#
CONFIG_NEWLIB_NANO_FORMAT=y

#
# FreeRTOS
#
CONFIG_FREERTOS_HZ=1000
```
